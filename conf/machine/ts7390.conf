## conf/machine/ts7390.conf
```bitbake
#@TYPE: Machine
#@Name: Technologic Systems TS-7390 SBC
#@DESCRIPTION: Machine configuration for Technologic Systems TS-7390 SBC

TARGET_ARCH = "arm"

PREFERRED_PROVIDER_virtual/kernel = "linux"
PREFERRED_VERSION_linux = "2.6.29.1"

MACHINE_FEATURES = "kernel26 ext2 usbhost"

SERIAL_CONSOLE = "115200 ttyAM0"
USE_VT = "0"
CMDLINE ?= "console=ttyAM0,115200 root=/dev/nfs nfsroot=192.168.1.50:/srv/nfsroot_ts7390 ip=192.168.1.52:192.168.1.50:192.168.1.1:255.255.255.0:ts7390:eth0:off"

require conf/machine/include/tune-arm920t.inc

ARM_KEEP_OABI_ts7390 = "1"
```

## conf/machine/ts7800.conf
```bitbake
#@TYPE: Machine
#@Name: Technologic Systems TS-7800 SBC
#@DESCRIPTION: Machine configuration for Technologic Systems TS-7800 SBC

TARGET_ARCH = "arm"

PREFERRED_PROVIDER_virtual/kernel = "linux"
PREFERRED_VERSION_linux = "2.6.28"

MACHINE_FEATURES = "kernel26 ext2 usbhost"

SERIAL_CONSOLE = "115200 ttyS0"
USE_VT = "0"
CMDLINE = "root=/dev/ram0 rw lpj=1662976 init=/linuxrc console=ttyS0,115200n8"

require conf/machine/include/tune-arm926ejs.inc

ARM_KEEP_OABI_ts7800 = "1"
```
